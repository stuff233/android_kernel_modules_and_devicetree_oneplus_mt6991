// SPDX-License-Identifier: (GPL-2.0 OR MIT)
/*
 * Copyright (C) 2022 MediaTek Inc.
 */
#include "k6991v1_64.dts"
#include <dt-bindings/pinctrl/mt6373-pinfunc.h>

&mrdump_ext_rst	{
	status = "disabled";
};

&mmlsys1_config {
	dl-enable;
};

/*End of this file, DO NOT ADD ANYTHING HERE*/

